## conf/layer.conf
```bitbake
# We have a conf and classes directory, add to BBPATH
BBPATH .= ":${LAYERDIR}"

# We have recipes-* directories, add to BBFILES
BBFILES += "${LAYERDIR}/recipes-*/*/*.bb ${LAYERDIR}/recipes-*/*/*.bbappend"

BBFILE_COLLECTIONS += "ai"
BBFILE_PATTERN_ai = "^${LAYERDIR}/"
BBFILE_PRIORITY_ai = "3"

# This should only be incremented on significant changes that will
# cause compatibility issues with other layers
LAYERVERSION_ai = "2"
LAYERDEPENDS_ai = "core"
```
